## dts/bindings/rtc/ti,cc13xx-cc26xx-rtc.yaml
```yaml
#
# Copyright (c) 2019, Texas Instruments Incorporated
#
# SPDX-License-Identifier: Apache-2.0
#

title: TI SimpleLink CC13xx/CC26xx RTC

description: >
    This binding gives a base representation of the TI SimpleLink CC13xx/CC26xx RTC

inherits:
    !include rtc.yaml

properties:
    compatible:
      constraint: "ti,cc13xx-cc26xx-rtc"

    reg:
      category: required
```

## samples/net/sockets/echo_server/boards/cc3235sf_launchxl.conf
```kconfig
# Networking Config for IPv4-only support
CONFIG_NET_NATIVE=n
CONFIG_NET_IPV6=n
CONFIG_NET_CONFIG_NEED_IPV6=n

# Enable SimpleLink WiFi Driver and Socket Offload
CONFIG_WIFI=y
CONFIG_WIFI_SIMPLELINK=y
CONFIG_NET_SOCKETS_OFFLOAD=y

# Disable unneeded settings from the base prj.conf:
CONFIG_DNS_RESOLVER=n
CONFIG_DNS_SERVER_IP_ADDRESSES=n
CONFIG_DNS_SERVER1=""
CONFIG_NET_CONFIG_SETTINGS=n
CONFIG_NET_CONFIG_MY_IPV4_ADDR=""
CONFIG_NET_CONFIG_MY_IPV4_GW=""
CONFIG_NET_CONFIG_PEER_IPV4_ADDR=""
CONFIG_NET_CONFIG_MY_IPV6_ADDR=""
CONFIG_NET_CONFIG_PEER_IPV6_ADDR=""
CONFIG_NET_CONNECTION_MANAGER=n
CONFIG_NET_STATISTICS=n
CONFIG_NET_SHELL=n

# Debugging
CONFIG_NET_LOG=y
CONFIG_WIFI_LOG_LEVEL_DBG=y
CONFIG_DEBUG=y
CONFIG_ASSERT=y
```
